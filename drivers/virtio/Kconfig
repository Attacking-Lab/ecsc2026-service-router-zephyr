## drivers/virtio/Kconfig
```kconfig
# Copyright (c) 2024 Antmicro <www.antmicro.com>
# SPDX-License-Identifier: Apache-2.0

config VIRTIO
	bool "support for VIRTIO"
	help
	  Enable options for VIRTIO

if VIRTIO

module = VIRTIO
module-str = VIRTIO
source "subsys/logging/Kconfig.template.log_config"

config VIRTIO_PCI
	bool "support for VIRTIO over PCI"
	default y
	depends on DT_HAS_VIRTIO_PCI_ENABLED
	help
	  Enable options for VIRTIO over PCI

config VIRTIO_MMIO
	bool "support for VIRTIO over MMIO"
	default y
	depends on DT_HAS_VIRTIO_MMIO_ENABLED
	help
	  Enable options for VIRTIO over MMIO

config VIRTIO_PCI_INIT_PRIORITY
	int "VIRTIO PCI init priority"
	default 45
	depends on VIRTIO_PCI
	help
	  Device initialization priority for the VIRTIO PCI transport.

	  On platforms where Zephyr enumerates the PCIe bus itself, this must be
	  greater than PCIE_INIT_PRIORITY: the controller assigns the BARs during
	  its own init, and the transport reads its configuration structures out
	  of a BAR. It must also be lower than the priority of the VIRTIO device
	  drivers sitting on top of it (KERNEL_INIT_PRIORITY_DEVICE).

endif # VIRTIO
```
